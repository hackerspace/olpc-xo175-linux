## drivers/devfreq/Kconfig
```kconfig
config ARCH_HAS_DEVFREQ
	bool
	help
	  Denotes that the architecture supports DEVFREQ. If the architecture
	  supports multiple OPP entries per device and the frequency of the
	  devices with OPPs may be altered dynamically, the architecture
	  supports DEVFREQ.

menuconfig PM_DEVFREQ
	bool "Generic Dynamic Voltage and Frequency Scaling (DVFS) support"
	help
	  With OPP support, a device may have a list of frequencies and
	  voltages available. DEVFREQ, a generic DVFS framework can be
	  registered for a device with OPP support in order to let the
	  governor provided to DEVFREQ choose an operating frequency
	  based on the OPP's list and the policy given with DEVFREQ.

	  Each device may have its own governor and policy. DEVFREQ can
	  reevaluate the device state periodically and/or based on the
	  OPP list changes (each frequency/voltage pair in OPP may be
	  disabled or enabled).

	  Like some CPUs with CPUFREQ, a device may have multiple clocks.
	  However, because the clock frequencies of a single device are
	  determined by the single device's state, an instance of DEVFREQ
	  is attached to a single device and returns a "representative"
	  clock frequency from the OPP of the device, which is also attached
	  to a device by 1-to-1. The device registering DEVFREQ takes the
	  responsiblity to "interpret" the frequency listed in OPP and
	  to set its every clock accordingly with the "target" callback
	  given to DEVFREQ.

if PM_DEVFREQ

comment "DEVFREQ Governors"

config DEVFREQ_GOV_SIMPLE_ONDEMAND
	bool "Simple Ondemand"
	help
	  Chooses frequency based on the recent load on the device. Works
	  similar as ONDEMAND governor of CPUFREQ does. A device with
	  Simple-Ondemand should be able to provide busy/total counter
	  values that imply the usage rate. A device may provide tuned
	  values to the governor with data field at devfreq_add_device().

config DEVFREQ_GOV_PERFORMANCE
	bool "Performance"
	help
	  Sets the frequency at the maximum available frequency.
	  This governor always returns UINT_MAX as frequency so that
	  the DEVFREQ framework returns the highest frequency available
	  at any time.

config DEVFREQ_GOV_POWERSAVE
	bool "Powersave"
	help
	  Sets the frequency at the minimum available frequency.
	  This governor always returns 0 as frequency so that
	  the DEVFREQ framework returns the lowest frequency available
	  at any time.

config DEVFREQ_GOV_USERSPACE
	bool "Userspace"
	help
	  Sets the frequency at the user specified one.
	  This governor returns the user configured frequency if there
	  has been an input to /sys/devices/.../power/devfreq_set_freq.
	  Otherwise, the governor does not change the frequnecy
	  given at the initialization.

comment "DEVFREQ Drivers"

config DDR_DEVFREQ
	bool "DDR devfreq driver support"
	help
	  This adds the ddr devfreq driver support.

config VMETA_DEVFREQ
	bool "vMeta devfreq driver"
	help
	  This adds the devfreq driver of vMeta

if VMETA_DEVFREQ
choice
	bool "vMeta devfreq default governor"
	default VMETA_DEVFREQ_DEFAULT_GOV_USERSPACE
	help
	  this selects the default governor of vMeta
	  devfreq driver

config VMETA_DEVFREQ_DEFAULT_GOV_PERFORMANCE
	bool "performance"
	select DEVFREQ_GOV_PERFORMANCE
	help
	  Use the DEVFreq governor 'performance' as default. This sets
	  the frequency statically to the highest frequency supported by
	  the vMeta.

config VMETA_DEVFREQ_DEFAULT_GOV_POWERSAVE
	bool "powersave"
	select DEVFREQ_GOV_POWERSAVE
	help
	  Use the DEVFreq governor 'powersave' as default. This sets
	  the frequency statically to the lowest frequency supported by
	  the vMeta.

config VMETA_DEVFREQ_DEFAULT_GOV_USERSPACE
	bool "userspace"
	select DEVFREQ_GOV_USERSPACE
	help
	  Use the DEVFreq governor 'userspace' as default. This allows
	  you to set the vMeta frequency manually or when a userspace
	  program shall be able to set the vMeta dynamically without having
	  to enable the userspace governor manually.

config VMETA_DEVFREQ_DEFAULT_GOV_SIMPLE_ONDEMAND
	bool "simple ondemand"
	select DEVFREQ_GOV_SIMPLE_ONDEMAND
	select DEVFREQ_GOV_PERFORMANCE
	help
	  Use the DEVFreq governor 'simple ondemand' as default. This allows
	  you to get a full dynamic frequency capable system by simply
	  loading your devfreq low-level hardware driver.
	  Be aware that not all devfreq drivers support the simple ondemand
	  governor. If unsure have a look at the help section of the
	  driver. Fallback governor will be the performance governor.
endchoice

endif # VMETA_DEVFREQ


endif # PM_DEVFREQ
```

## drivers/gpu/drm/i2c/Kconfig
```kconfig
menu "I2C encoder or helper chips"
     depends on DRM && DRM_KMS_HELPER && I2C

config DRM_I2C_CH7006
	tristate "Chrontel ch7006 TV encoder"
	default m if DRM_NOUVEAU
	help
	  Support for Chrontel ch7006 and similar TV encoders, found
	  on some nVidia video cards.

	  This driver is currently only useful if you're also using
	  the nouveau driver.

config DRM_I2C_SIL164
	tristate "Silicon Image sil164 TMDS transmitter"
	default m if DRM_NOUVEAU
	help
	  Support for sil164 and similar single-link (or dual-link
	  when used in pairs) TMDS transmitters, used in some nVidia
	  video cards.

config DRM_I2C_NXP_TDA998X
	tristate "NXP Semiconductors TDA998X HDMI encoder"
	default m if DRM_TILCDC
	select CEC_CORE if CEC_NOTIFIER
	select SND_SOC_HDMI_CODEC if SND_SOC
	help
	  Support for NXP Semiconductors TDA998X HDMI encoders.

config DRM_I2C_NXP_TDA9950
	tristate "NXP Semiconductors TDA9950/TDA998X HDMI CEC"
	select CEC_NOTIFIER
	select CEC_CORE

config DRM_I2C_HX8837
	tristate "HiMax HX8837 OLPC Display Controller"
	select BACKLIGHT_LCD_SUPPORT
	select BACKLIGHT_CLASS_DEVICE
	help
	  Support for HiMax HX8837 Display Controller on an OLPC XO laptop.

	  The HX8837 encodes R5G6B6 signal from the CRTC for panel's DETTL
	  interface, optionally enabing color swizzling. It is also capable
	  of freezing a single frame with LCD controller turned off for low
	  power operation and controlling the backlight.

	  If your laptop doesn't have green ears, say "N"
endmenu
```

## drivers/media/video/cmmb/Kconfig
```kconfig
menuconfig CMMB
	tristate "China Mobile Multimedia Broadcasting"
	---help---
	  CMMB is a mobile television and multimedia standard developed
	  and specified in China by the State Administration of Radio,
	  Film, and Television (SARFT).

if CMMB
endif #CMMB
```

## drivers/media/video/ecs/Kconfig
```kconfig
config ECS_DRIVER
	tristate "Essential Camera Sensor driver framework"
	depends on VIDEO_V4L2 && SOC_CAMERA
	default n
	help
	  Essential Camera Sensor(AKA: ECS) is a abstract description of
	  camera sensors. Can be used to creat a specific camera sensor
	  driver, like ov5640 driver.
```

## drivers/net/wireless/marvell/libertas_tf/Kconfig
```kconfig
config LIBERTAS_THINFIRM
	tristate "Marvell 8xxx Libertas WLAN driver support with thin firmware"
	depends on MAC80211
	select FW_LOADER
	---help---
	  A library for Marvell Libertas 8xxx devices using thinfirm.

config LIBERTAS_THINFIRM_DEBUG
	bool "Enable full debugging output in the Libertas thin firmware module."
	depends on LIBERTAS_THINFIRM
	---help---
	  Debugging support.

config LIBERTAS_THINFIRM_SDIO
        tristate "Marvell Libertas 8686 SDIO 802.11b/g cards"
        depends on LIBERTAS_THINFIRM && MMC
        ---help---
          A driver for Marvell Libertas 8686 SDIO devices and those that include
          the 88W8686 core, such as the Wi2Wi devices.  Special SDIO specific
          firmware is required to use this driver, see the OLPC site for details:

          <http://wiki.laptop.org/go/Thinfirm_1.5>

config LIBERTAS_THINFIRM_USB
	tristate "Marvell Libertas 8388 USB 802.11b/g cards with thin firmware"
	depends on LIBERTAS_THINFIRM && USB
	---help---
	  A driver for Marvell Libertas 8388 USB devices using thinfirm.
```

## drivers/platform/Kconfig
```kconfig
# SPDX-License-Identifier: GPL-2.0-only
if X86
source "drivers/platform/x86/Kconfig"
endif
if MIPS
source "drivers/platform/mips/Kconfig"
endif

source "drivers/platform/goldfish/Kconfig"

source "drivers/platform/chrome/Kconfig"

source "drivers/platform/mellanox/Kconfig"

source "drivers/platform/olpc/Kconfig"

config ENE_EC
        tristate "ENE Embedded Controller"
        depends on I2C
        help
	  ENE EC.
```

## drivers/platform/olpc/Kconfig
```kconfig
config OLPC
	tristate "One Laptop Per Child support"
	depends on X86 || ARM || COMPILE_TEST
	depends on !X86_PAE
	select GPIOLIB
	select OF
	select OF_PROMTREE if X86
	select IRQ_DOMAIN
	select REGULATOR
	help
	  Add support for detecting the unique features of the OLPC
	  XO hardware.

if OLPC

config OLPC_XO175_EC
	tristate "OLPC XO 1.75 Embedded Controller"
	depends on ARCH_MMP || COMPILE_TEST
	select SPI_SLAVE
	help
	  Include support for the OLPC XO Embedded Controller (EC). The EC
	  provides various platform services, including support for the power,
	  button, restart, shutdown and battery charging status.

	  Unless you have an OLPC XO laptop, you will want to say N.

endif
```

## drivers/switch/Kconfig
```kconfig
menuconfig SWITCH
	tristate "Switch class support"
	help
	  Say Y here to enable switch class support. This allows
	  monitoring switches by userspace via sysfs and uevent.

if SWITCH

config SWITCH_GPIO
	tristate "GPIO Swith support"
	depends on GENERIC_GPIO
	help
	  Say Y here to enable GPIO based switch support.

config SWITCH_HEADSET
        tristate "Headset Swith support"
        depends on GENERIC_GPIO
        help
          Say Y here to enable headset & hook switch support.

config SWITCH_HEADSET_HOST_GPIO
	bool "Headset Switch Host GPIO support"
	depends on MACH_ABILENE || MACH_YELLOWSTONE
	help
	  To support headset switch (detection), this option must
	  be selected. This option makes Host GPIO to be configured
	  as input to receive the interrupt.

config SWITCH_WM8994_HEADSET
	tristate "Headset Swith support"
	depends on GENERIC_GPIO
	depends on SWITCH_HEADSET_HOST_GPIO
	  help
	  Say Y here to enable wm8994 headset switch support.

endif # SWITCH
```
