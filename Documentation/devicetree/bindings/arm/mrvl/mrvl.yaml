## Documentation/devicetree/bindings/arm/mrvl/mrvl.yaml
```yaml
# SPDX-License-Identifier: GPL-2.0
%YAML 1.2
---
$id: http://devicetree.org/schemas/arm/mrvl/mrvl.yaml#
$schema: http://devicetree.org/meta-schemas/core.yaml#

title: Marvell Platforms Device Tree Bindings

maintainers:
  - Lubomir Rintel <lkundrak@v3.sk>

properties:
  $nodename:
    const: '/'
  compatible:
    oneOf:
      - description: PXA168 Aspenite Board
        items:
          - enum:
              - mrvl,pxa168-aspenite
          - const: mrvl,pxa168
      - description: PXA910 DKB Board
        items:
          - enum:
              - mrvl,pxa910-dkb
      - description: MMP2 Brownstone Board
        items:
          - enum:
              - mrvl,mmp2-brownstone
          - const: mrvl,mmp2
      - description: MMP3 SoC
        items:
          - const: mrvl,mmp3
...
```

## Documentation/devicetree/bindings/display/armada/marvell-armada-drm.txt
```
Marvell Armada DRM master device
================================

The Marvell Armada DRM master device is a virtual device needed to list all
nodes that comprise the graphics subsystem.

Required properties:

 - compatible: value should be "marvell,dove-display-subsystem",
   "marvell,armada-display-subsystem"
 - ports: a list of phandles pointing to display interface ports of CRTC
   devices
 - memory-region: phandle to a node describing memory to be used for the
   framebuffer

Example:

	display-subsystem {
		compatible = "marvell,dove-display-subsystem",
		             "marvell,armada-display-subsystem";
		memory-region = <&display_reserved>;
		ports = <&lcd0_port>;
	};

Marvell Armada LCD controller
=============================

Required properties:

 - compatible: value should be "marvell,dove-lcd".
 - reg: base address and size of the LCD controller
 - interrupts: single interrupt number for the LCD controller

Optional properties:

 - clocks: as described by clock-bindings.txt
 - clock-names: as described by clock-bindings.txt
	"axiclk" - axi bus clock for pixel clock
	"plldivider" - pll divider clock for pixel clock
	"ext_ref_clk0" - external clock 0 for pixel clock
	"ext_ref_clk1" - external clock 1 for pixel clock

Note: all clocks are optional but at least one must be specified.
Further clocks may be added in the future according to requirements of
different SoCs.

Required child nodes:

- port: video output port with endpoints, as described by
  Documentation/devicetree/bindings/graph.txt

Example:

	lcd0: lcd-controller@820000 {
		compatible = "marvell,dove-lcd";
		reg = <0x820000 0x1000>;
		interrupts = <47>;
		clocks = <&si5351 0>;
		clock-names = "ext_ref_clk_1";

		lcd0_port: port {
			lcd0_rgb_out: endpoint {
				remote-endpoint = <&encoder_rgb_in>;
			};
		};
	};

Marvell Armada framebuffer reserved memory
==========================================

Memory set aside for allocation of Marvell Armada framebuffer objects.

Required properties:

 - compatible: value should be "marvell,dove-framebuffer",
   "marvell,armada-framebuffer".

This binding is compatible with the binding, specified in
Documentation/devicetree/bindings/reserved-memory/reserved-memory.txt..

Example:

	reserved-memory {
		display_reserved: framebuffer {
			compatible = "marvell,dove-framebuffer",
			             "marvell,armada-framebuffer";
			size = <0x02000000>;
			alignment = <0x02000000>;
			no-map;
		};
	};
```

## Documentation/devicetree/bindings/display/bridge/himax,hx8837.txt
```
HX8837 Display Controller

Required properties:
- compatible: Should be "himax,hx8837".
- reg: I2C address, must be 0x0d
- stat-gpios: gpio specifier of DCON_STAT0 and DCON_STAT1 pins (active high)
- load-gpios: gpio specifier of DCON_LOAD pin (active high)
- interrupt: interrupt specifier of DCON_IRQ pin (edge falling)

Required nodes:
- ports: contains port nodes with endpoints, as described in
  Documentation/devicetree/bindings/graph.txt
  Port 0's endpoint is connected to the LCD controller's RGB data output
  endpoint.
  Port 1's endpoint is connected to the panel's input endpoint.

Example:
	dcon@d {
		compatible = "himax,hx8837";
		reg = <0x0d>;
		stat-gpios = <&gpio 100 GPIO_ACTIVE_HIGH
			      &gpio 101 GPIO_ACTIVE_HIGH>;
		load-gpios = <&gpio 142 GPIO_ACTIVE_HIGH>;
		interrupts = <&gpio 124 IRQ_TYPE_EDGE_FALLING>;

		ports {
			#address-cells = <0x01>;
			#size-cells = <0x00>;

			port@0 {
				reg = <0x00>;
				dcon_rgb_in: endpoint {
					remote-endpoint = <&lcd0_rgb_out>;
				};
			};

			port@1 {
				reg = <0x01>;
				dcon_gettl_out: endpoint {
					remote-endpoint = <&panel_dettl_in>;
				};
			};
		};
	};
```

## Documentation/devicetree/bindings/display/bridge/himax,hx8837.yaml
```yaml
# SPDX-License-Identifier: (GPL-2.0-only OR BSD-2-Clause)
# Copyright (C) 2018,2019,2020,2021 Lubomir Rintel <lkundrak@v3.sk>
%YAML 1.2
---
$id: http://devicetree.org/schemas/display/bridge/himax,hx8837.yaml#
$schema: http://devicetree.org/meta-schemas/core.yaml#

title: HX8837 Display Controller Device Tree Bindings

maintainers:
  - Lubomir Rintel <lkundrak@v3.sk>

properties:
  compatible:
    const: himax,hx8837

  reg:
    const: 0xd

  load-gpios:
    maxItems: 1
    description: GPIO specifier of DCON_LOAD pin (active high)

  stat-gpios:
    minItems: 2
    description: GPIO specifier of DCON_STAT0 and DCON_STAT1 pins (active high)

  interrupts:
    maxItems: 1
    description: Interrupt specifier of DCON_IRQ pin (edge falling)

  vddp18-supply:
    description: Regulator for 1.8V display interface I/O power.

  vddm25-supply:
    description: Regulator for 2.5V SDRAM I/O power.

  vdd33-supply:
    description: Regulator for 3.3V digital I/O power.

  vddk18-supply:
    description: Regulator for 1.8V internal core power.

  ports:
    type: object

    properties:
      port@0:
        type: object
        description: |
          Video port for RGB input.

      port@1:
        type: object
        description: |
          Video port connected to the panel.

    required:
      - port@0
      - port@1

required:
  - compatible
  - reg
  - interrupts
  - ports

additionalProperties: false

examples:
  - |
    #include <dt-bindings/gpio/gpio.h>
    #include <dt-bindings/interrupt-controller/irq.h>

    i2c {
        #address-cells = <1>;
        #size-cells = <0>;

        lcd-controller@d {
            compatible = "himax,hx8837";
            reg = <0x0d>;
            stat-gpios = <&gpio 100 GPIO_ACTIVE_HIGH>,
                         <&gpio 101 GPIO_ACTIVE_HIGH>;
            load-gpios = <&gpio 142 GPIO_ACTIVE_HIGH>;
            interrupts = <&gpio 124 IRQ_TYPE_EDGE_FALLING>;

            ports {
                #address-cells = <1>;
                #size-cells = <0>;

                port@0 {
                    reg = <0>;
                    dcon_rgb_in: endpoint {
                        remote-endpoint = <&lcd0_rgb_out>;
                    };
                };

                port@1 {
                    reg = <1>;
                    dcon_gettl_out: endpoint {
                        remote-endpoint = <&panel_dettl_in>;
                    };
                };
            };
        };
    };

...
```

## Documentation/devicetree/bindings/display/marvell,armada-lcdc.txt
```
Marvell Armada LCD controller
=============================

Required properties:

 - compatible: value should be "marvell,dove-lcd" or "marvell,mmp2-lcd",
   depending on the exact SoC model, along with "marvell,armada-lcdc"
 - reg: base address and size of the LCD controller
 - interrupts: single interrupt number for the LCD controller

Optional properties:

 - clocks: as described by clock-bindings.txt
 - clock-names: as described by clock-bindings.txt
	"axiclk" - axi bus clock for pixel clock
	"plldivider" - pll divider clock for pixel clock
	"ext_ref_clk0" - external clock 0 for pixel clock
	"ext_ref_clk1" - external clock 1 for pixel clock

Note: all clocks are optional but at least one must be specified.
Further clocks may be added in the future according to requirements of
different SoCs.

Required child nodes:

- port: video output port with endpoints, as described by
  Documentation/devicetree/bindings/graph.txt
  The endpoints can optionally specify the following property:

  - bus-width: recognized values are <12>, <16>, <18> and <24>, that
    select "rgb444", "rgb565", "rgb666" or "rgb888" pixel format
    respectively. Defaults to <24> if unspecified.

Example:

	lcd0: lcd-controller@820000 {
		compatible = "marvell,dove-lcd";
		reg = <0x820000 0x1000>;
		interrupts = <47>;
		clocks = <&si5351 0>;
		clock-names = "ext_ref_clk_1";

		lcd0_port: port {
			lcd0_rgb_out: endpoint {
				bus-width = <24>;
				remote-endpoint = <&encoder_rgb_in>;
			};
		};
	};
```

## Documentation/devicetree/bindings/display/marvell,armada-lcdc.yaml
```yaml
# SPDX-License-Identifier: GPL-2.0
%YAML 1.2
---
$id: http://devicetree.org/schemas/display/marvell,armada-lcdc.yaml#
$schema: http://devicetree.org/meta-schemas/core.yaml#

title: Marvell Armada LCD Controller Bindings

maintainers:
  - Russell King <linux@armlinux.org.uk>

allOf:
  - if:
      properties:
        compatible:
          contains:
            const: marvell,dove-lcd
    then:
      properties:
        clock-names:
          contains:
            enum:
              - axiclk        # AXI bus clock for pixel clock
              - ext_ref_clk0  # External clock 0 for pixel clock
              - plldivider    # PLL divider clock for pixel clock
              - ext_ref_clk1  # External clock 1 for pixel clock
  - if:
      properties:
        compatible:
          contains:
            const: marvell,mmp2-lcd
    then:
      properties:
        clock-names:
          contains:
            enum:
              - axiclk        # AXI bus clock for pixel clock
              - disp0         # LCD Display clock 1 for pixel clock
              - disp1         # LCD Display clock 2 for pixel clock
              - hdmi_pll      # HDMI PLL for pixel clock
  - if:
      properties:
        compatible:
          contains:
            const: marvell,mmp3-lcd
    then:
      properties:
        clock-names:
          contains:
            enum:
              - axiclk        # AXI bus clock for pixel clock
              - disp0         # LCD Display clock 1 for pixel clock
              - disp1         # LCD Display clock 2 for pixel clock
              - hdmi_pll      # HDMI PLL for pixel clock
              - pll3          # PLL3 for pixel clock

properties:
  compatible:
    items:
      - enum:
          - marvell,dove-lcd
          - marvell,mmp2-lcd
          - marvell,mmp3-lcd
      - const: marvell,armada-lcdc

  reg:
    maxItems: 1

  interrupts:
    maxItems: 1

  clocks:
    minItems: 1

  clock-names: true

  ports:
    type: object
    description:
      Video output ports with endpoints, as described by
      Documentation/devicetree/bindings/graph.txt.
    properties:
      '#address-cells':
        const: 1

      '#size-cells':
        const: 0

      port@0:
        type: object
        description:
          RGB video output port.

        properties:
          endpoint:
            type: object

            properties:
              remote-endpoint: true
              bus-width:
                description:
                  A value of 12, 16, 18 and 24, that select "rgb444", "rgb565",
                  "rgb666" or "rgb888" pixel format respectively. Defaults to
                  24 if unspecified.
                enum: [ 12, 16, 18, 24 ]

            required:
              - remote-endpoint

            additionalProperties: false

        required:
          - endpoint

        additionalProperties: false

      port@1:
        type: object
        description:
          HDMI video output port.

        properties:
          endpoint:
            type: object

            properties:
              remote-endpoint: true

            required:
              - remote-endpoint

            additionalProperties: false

        required:
          - endpoint

        additionalProperties: false

    required:
      - port@0

required:
  - compatible
  - reg
  - interrupts
  - clocks
  - clock-names
  - port

additionalProperties: false

examples:
  - |
    lcd-controller@820000 {
        compatible = "marvell,dove-lcd", "marvell,armada-lcdc";
        reg = <0x820000 0x1000>;
        interrupts = <47>;
        clocks = <&si5351 0>;
        clock-names = "ext_ref_clk1";

        ports {
            #address-cells = <1>;
            #size-cells = <0>;

            port@0 {
                reg = <0>;
                lcd0_rgb_out: endpoint {
                    bus-width = <24>;
                    remote-endpoint = <&encoder_rgb_in>;
                };
            };
        };
    };
```

## Documentation/devicetree/bindings/display/panel/innolux,ls075at011.txt
```
Innolux LS075AT011 7.5" 1200x900 panel

Required properties:
- compatible: should be "innolux,ls075at011", "simple-panel"

This binding is compatible with the simple-panel binding, which is specified
in simple-panel.txt in this directory.
```

## Documentation/devicetree/bindings/media/marvell,mmp2-ccic.txt
```
Marvell MMP2 camera host interface

Required properties:
 - compatible: Should be "marvell,mmp2-ccic".
 - reg: Register base and size.
 - interrupts: The interrupt number.
 - #clock-cells: Nust be 0.

Optional properties:
 - clocks: Reference to the input clock as specified by
           Documentation/devicetree/bindings/clock/clock-bindings.txt.
 - clock-names: Names of the clocks used; "axi" for the AXI bus interface,
                "func" for the peripheral clock and "phy" for the parallel
                video bus interface.
 - clock-output-names: Optional clock source for sensors. Shall be "mclk".

Required subnodes:
 - port: The parallel bus interface port with a single endpoint linked to
         the sensor's endpoint as described in
         Documentation/devicetree/bindings/media/video-interfaces.txt.

Example:

	camera0: camera@d420a000 {
		compatible = "marvell,mmp2-ccic";
		reg = <0xd420a000 0x800>;
		interrupts = <42>;
		clocks = <&soc_clocks MMP2_CLK_CCIC0>;
		clock-names = "axi";
		#clock-cells = <0>;
		clock-output-names = "mclk";

		port {
			camera0_0: endpoint {
				remote-endpoint = <&ov7670_0>;
			};
		};
	};
```

## Documentation/devicetree/bindings/mfd/ene-kb3930.yaml
```yaml
# SPDX-License-Identifier: BSD-2-Clause OR GPL-2.0-or-later
%YAML 1.2
---
$id: http://devicetree.org/schemas/mfd/ene-kb3930.yaml#
$schema: http://devicetree.org/meta-schemas/core.yaml#

title: ENE KB3930 Embedded Controller bindings

description: |
  This binding describes the ENE KB3930 Embedded Controller attached to a
  I2C bus.

maintainers:
  - Lubomir Rintel <lkundrak@v3.sk>

properties:
  compatible:
    const: ene,kb3930

  reg:
    maxItems: 1

  power-gpios:
    description: GPIO used for the power pin
    maxItems: 2

  system-power-controller: true

required:
  - compatible
  - reg

additionalProperties: false

examples:
  - |
    embedded-controller@58 {
      compatible = "ene,kb3930";
      reg = <0x58>;
      system-power-controller;

      off-gpios = <&gpio 126 GPIO_ACTIVE_HIGH>,
                  <&gpio 127 GPIO_ACTIVE_HIGH>;
    };

...
```

## Documentation/devicetree/bindings/misc/himax,hx8837.txt
```
HX8837 Display Controller

Required properties:
- compatible: Should be "himax,hx8837".
- reg: I2C address, must be 0x0d
- stat-gpios: gpio specifier of DCON_STAT0 and DCON_STAT1 pins (active high)
- load-gpios: gpio specifier of DCON_LOAD pin (active high)
- interrupt: interrupt specifier of DCON_IRQ pin (edge falling)

Example:
	dcon@d {
		compatible = "himax,hx8837";
		reg = <0x0d>;
		stat-gpios = <&gpio 100 GPIO_ACTIVE_HIGH
			      &gpio 101 GPIO_ACTIVE_HIGH>;
		load-gpios = <&gpio 142 GPIO_ACTIVE_HIGH>;
		interrupts = <&gpio 124 IRQ_TYPE_EDGE_FALLING>;
	};
```
